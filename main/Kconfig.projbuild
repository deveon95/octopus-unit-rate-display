## main/Kconfig.projbuild
```kconfig
menu "Application Configuration"

	config ESP_WIFI_SSID
		string "WiFi SSID"
		default "myssid"
		help
			SSID (network name) for the example to connect to.

	config ESP_WIFI_PASSWORD
		string "WiFi Password"
		default "mypassword"
		help
			WiFi password (WPA or WPA2) for the example to use.

	config ESP_MAXIMUM_RETRY
		int "Maximum retry"
		default 5
		help
			Set the Maximum retry to avoid station reconnecting to the AP unlimited when the AP is really inexistent.

	config ESP_TARIFF
		string "Tariff code Tracker"
		default "SILVER-FLEX-22-11-25"
		help
			Set your product code

	config ESP_TARIFF_ELEC
		string "Tariff code Elec Tracker"
		default "E-1R-SILVER-FLEX-22-11-25-E"
		help
			Set your tariff code; includes fuel type and region code

	config ESP_TARIFF_GAS
		string "Tariff code Gas Tracker"
		default "G-1R-SILVER-FLEX-22-11-25-E"
		help
			Set your tariff code; includes fuel type and region code
            
	config ESP_TARIFF_FLEX_ENABLE
		int "Enable display of the Flexible tariff"
		default 1
		help
			0 = Disabled, 1 = Enabled
            
	config ESP_TARIFF_FLEX
		string "Product name for Flexible tariff"
		default "VAR-22-11-01"
		help
			Set your product code
            
	config ESP_TARIFF_ELEC_FLEX
		string "Tariff code Elec Flexible"
		default "E-1R-VAR-22-11-01-E"
		help
			Set your tariff code; includes fuel type and region code

	config ESP_TARIFF_GAS_FLEX
		string "Tariff code Gas Flexible"
		default "G-1R-VAR-22-11-01-E"
		help
			Set your tariff code; includes fuel type and region code
            
	config ESP_TARIFF_AGILE_ENABLE
		int "Enable display of the Agile tariff"
		default 1
		help
			0 = Disabled, 1 = Enabled
            
    config ESP_TARIFF_AGILE
        string "Product code for Agile tariff"
        default "AGILE-FLEX-BB-23-02-08"
        help
            Set the product code
    
    config ESP_TARIFF_ELEC_AGILE
        string "Tariff code for Elec Agile"
        default "E-1R-AGILE-FLEX-BB-23-02-08-E"
        help
            Set your tariff code; includes fuel type and region code

endmenu
```
